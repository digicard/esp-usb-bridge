## main/Kconfig.projbuild
```kconfig
menu "Bridge Configuration"

  config BRIDGE_USB_VID
      hex "USB vendor ID"
      default 0x303A

  config BRIDGE_USB_PID
      hex "USB product ID"
      default 0x1002

  config BRIDGE_MANUFACTURER
      string "USB bridge manufacturer"
      default "Espressif Systems Co. Ltd."

  config BRIDGE_PRODUCT_NAME
      string "USB product name"
      default "ESP USB Bridge"

  config BRIDGE_GPIO_BOOT
      int "GPIO pin for the BOOT signal"
      default 4

  config BRIDGE_GPIO_RST
      int "GPIO pin for the RESET signal"
      default 7

  config BRIDGE_GPIO_RXD
      int "GPIO pin for the RxD signal"
      default 6

  config BRIDGE_GPIO_TXD
      int "GPIO pin for the TxD signal"
      default 5

  config BRIDGE_GPIO_TDI
      int "GPIO pin for the target TDI signal"
      default 3

  config BRIDGE_GPIO_TDO
      int "GPIO pin for the target TDO signal"
      default 9

  config BRIDGE_GPIO_TCK
      int "GPIO pin for the target TCK signal"
      default 10

  config BRIDGE_GPIO_TMS
    int "GPIO pin for the target TMS signal"
    default 8

  # choice RGB_BLINK_LED
  #   prompt "Blink LED type"
  #   default RGB_BLINK_LED_GPIO if IDF_TARGET_ESP32 || !SOC_RMT_SUPPORTED
  #   default RGB_BLINK_LED_RMT
  #   help
  #     Defines the default peripheral for blink example

  #   config RGB_BLINK_LED_GPIO
  #     bool "GPIO"
  #   config RGB_BLINK_LED_RMT
  #     bool "RMT - Addressable LED"
  # endchoice

  config RGB_BLINK_GPIO
    int "Blink GPIO number"
    range 0 35
    default 5 if IDF_TARGET_ESP32
    default 18 if IDF_TARGET_ESP32S2
    default 48 if IDF_TARGET_ESP32S3
    default 8
    help
      GPIO number (IOxx) to blink on and off or the RMT signal for the addressable LED.
      Some GPIOs are used for other purposes (flash connections, etc.) and cannot be used to blink.

  config RGB_BLINK_PERIOD
    int "Blink period in ms"
    range 10 3600000
    default 500
    help
        Define the blinking period in milliseconds.

  config RGB_BRIGHNESS
    int "RGB LED brightness (0-255)"
    range 0 255
    default 128
    help
        Define the relative brightness of the RGB LED.

  config BRIDGE_GPIO_LED1
      int "GPIO pin LED1"
      default 12

  config BRIDGE_GPIO_LED2
      int "GPIO pin LED2"
      default 13

  config BRIDGE_GPIO_LED3
      int "GPIO pin LED3"
      default 14

  config BRIDGE_GPIO_LED1_ACTIVE
      int "GPIO pin LED1 active value"
      range 0 1
      default 0

  config BRIDGE_GPIO_LED2_ACTIVE
      int "GPIO pin LED2 active value"
      range 0 1
      default 0

  config BRIDGE_GPIO_LED3_ACTIVE
      int "GPIO pin LED3 active value"
      range 0 1
      default 0

  config BRIDGE_MSC_VOLUME_LABEL
      string "Volume label shown in the MSC disc"
      default "ESPPROG_MSC"
      help
          Volume label shown in the MSC disc. Max lenght is 11 ASCII characters.

endmenu
```
